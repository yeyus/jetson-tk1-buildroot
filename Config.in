## Config.in
```kconfig
source "$BR2_EXTERNAL_JETSON_TK1_PATH/package/k3s/Config.in"
source "$BR2_EXTERNAL_JETSON_TK1_PATH/package/jetson-firmware/Config.in"
```

## configs/jetson-tk1_defconfig
```kconfig
BR2_arm=y
BR2_cortex_a9=y
BR2_GLOBAL_PATCH_DIR="$(BR2_EXTERNAL_JETSON_TK1_PATH)/patches/"
BR2_TOOLCHAIN_BUILDROOT_GLIBC=y
BR2_PACKAGE_HOST_LINUX_HEADERS_CUSTOM_4_14=y
BR2_TOOLCHAIN_BUILDROOT_CXX=y
BR2_TARGET_GENERIC_HOSTNAME="jetson-tk1"
BR2_TARGET_GENERIC_ISSUE="Welcome to Jetson TK1 mainline"
BR2_INIT_SYSTEMD=y
BR2_TARGET_GENERIC_ROOT_PASSWD="jetson"
BR2_SYSTEM_BIN_SH_BASH=y
# BR2_TARGET_GENERIC_GETTY is not set
BR2_SYSTEM_DHCP="eth0"
BR2_ROOTFS_OVERLAY="$(BR2_EXTERNAL_JETSON_TK1_PATH)/board/jetson-tk1/overlay/"
BR2_LINUX_KERNEL=y
BR2_LINUX_KERNEL_CUSTOM_VERSION=y
BR2_LINUX_KERNEL_CUSTOM_VERSION_VALUE="4.14.178"
BR2_LINUX_KERNEL_USE_CUSTOM_CONFIG=y
BR2_LINUX_KERNEL_CUSTOM_CONFIG_FILE="$(BR2_EXTERNAL_JETSON_TK1_PATH)/board/jetson-tk1/kernel.config"
BR2_LINUX_KERNEL_DTS_SUPPORT=y
BR2_LINUX_KERNEL_INTREE_DTS_NAME="tegra124-jetson-tk1"
BR2_LINUX_KERNEL_CONFIG_FRAGMENT_FILES="$(BR2_EXTERNAL_JETSON_TK1_PATH)/board/jetson-tk1/linux-jetson-firmware.fragment"
BR2_PACKAGE_LINUX_TOOLS_CPUPOWER=y
BR2_PACKAGE_LINUX_TOOLS_GPIO=y
BR2_PACKAGE_BZIP2=y
BR2_PACKAGE_GZIP=y
BR2_PACKAGE_UNZIP=y
BR2_PACKAGE_GIT=y
BR2_PACKAGE_E2FSPROGS=y
BR2_PACKAGE_I2C_TOOLS=y
BR2_PACKAGE_LSHW=y
BR2_PACKAGE_USBUTILS=y
BR2_PACKAGE_LIBNL=y
BR2_PACKAGE_ETHTOOL=y
BR2_PACKAGE_IPTABLES=y
BR2_PACKAGE_IPTABLES_NFTABLES=y
BR2_PACKAGE_IPUTILS=y
BR2_PACKAGE_NETCAT=y
BR2_PACKAGE_OPENSSH=y
BR2_PACKAGE_WGET=y
BR2_PACKAGE_BASH_COMPLETION=y
BR2_PACKAGE_TMUX=y
BR2_PACKAGE_HTOP=y
BR2_PACKAGE_TAR=y
BR2_PACKAGE_LESS=y
BR2_PACKAGE_NANO=y
BR2_PACKAGE_K3S=y
BR2_PACKAGE_JETSON_FIRMWARE=y
BR2_PACKAGE_JETSON_FIRMWARE_XUSB=y
BR2_PACKAGE_JETSON_FIRMWARE_RTL816x=y
BR2_PACKAGE_JETSON_FIRMWARE_NOUVEAU=y
```

## package/jetson-firmware/Config.in
```kconfig
config BR2_PACKAGE_JETSON_FIRMWARE
    bool "jetson-firmware"
    help
      Gather firmware files for jetson tk1 board

if BR2_PACKAGE_JETSON_FIRMWARE

config BR2_PACKAGE_JETSON_FIRMWARE_XUSB
    bool "XUSB"
    help
      This option will include the firmware for the USB3.0 controller

config BR2_PACKAGE_JETSON_FIRMWARE_RTL816x
    bool "RTL816x"
    help
      This option will include the firmware for the NIC in the Jetson TK1 board

config BR2_PACKAGE_JETSON_FIRMWARE_NOUVEAU
    bool "Nouveau"
    help
      This option will include firmware files to support GPU in Tegra K1 SOC

endif 
```

## package/k3s/Config.in
```kconfig
config BR2_PACKAGE_K3S
	bool "k3s"
	select BR2_PACKAGE_CA_CERTIFICATES
	help
	  Installs k3s armhf binary. Depends on ca-certificates package.
```
